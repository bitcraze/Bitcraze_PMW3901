#include "Bitcraze_PMW3901.h"


#include <Adafruit_GFX.h>    // Core graphics library
#include <Adafruit_ST7735.h> // Hardware-specific library
//defines for TFT 
#define TFT_CS        9
#define TFT_RST       8
#define TFT_DC        7
Adafruit_ST7735 tft = Adafruit_ST7735(TFT_CS, TFT_DC, TFT_RST);
int PixelScale = 3;


// Using digital pin 10 for chip select
Bitcraze_PMW3901 flow(10);
char frame[35*35]; //array to hold the framebuffer

const PROGMEM uint16_t ironhot[] =  
{0x0000,0x0000,0x0000,0x0000,0x0000,0x0020,0x0020,
0x0020,0x0020,0x0020,0x0841,0x0841,0x0841,0x0841,
0x0841,0x0841,0x0861,0x0861,0x0861,0x0861,0x0861,
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0xdefb,0xdefb,0xe71c};

void setup() {
  Serial.begin(115200);
  tft.initR(INITR_GREENTAB);   // initialize a ST7735S chip, 144 is 1.44 in display
   tft.fillScreen(ST7735_BLACK); //Fill black
   tft.setRotation(3);   //this specifies the rotation
   
  if (!flow.begin()) {
    Serial.println("Initialization of the flow sensor failed");
    tft.fillScreen(ST7735_RED); 
    delay(100);
    tft.fillScreen(ST7735_BLACK); //Flash screen red to indicate error
    delay(100);
    tft.fillScreen(ST7735_RED); 
    while(1) { }
  }
 
 flow.enableFrameBuffer(); 
 Serial.println("framebuffer init");
}


void loop() {
  flow.readFrameBuffer(frame);
  Serial.println("framebuffer read");
  int i,j,k;
  for(i=0, k=0; i<35; i++){ //i is Y pixel pos
    for(j=0; j<35; j++, k++){  //j is X pixel pos
      //Serial.print(asciiart(frame[k]));
      Serial.print(' ');
      uint8_t colorIndex = frame[k];
      Serial.print(frame[k]); //print pixel count contained data 
    //draw the pixels!
        tft.fillRect(4+PixelScale * i, 4+PixelScale * j, PixelScale, PixelScale, ironhot[colorIndex]); //Scale up function to fill screen
      }
     Serial.println();
  }
  Serial.println();
}


char asciiart(int k){ //converter magic? Higher value shunts more right in char array 
  static char foo[] = "WX86*3I>!;~:,`. ";
  return foo[k>>4]; //return shunted from array value character
}
